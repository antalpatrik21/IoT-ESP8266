#include <ESP8266WiFi.h>
#include <SPI.h>
#include <Wire.h>
#include <Adafruit_GFX.h>
#include <Adafruit_SSD1306.h>

#define SCREEN_WIDTH 128 // OLED display width, in pixels
#define SCREEN_HEIGHT 64 // OLED display height, in pixels

#define OLED_RESET  LED_BUILTIN //

#define LOGO_HEIGHT   16
#define LOGO_WIDTH    16

Adafruit_SSD1306 display(SCREEN_WIDTH, SCREEN_HEIGHT, &Wire, OLED_RESET);

#define detectedLED D7
#define readyLED D8
#define waitLED D0
#define sensor D6
#define speaker D5
// 'sleep', 128x64px
const unsigned char sleep [] PROGMEM = {
  0x00, 0x00, 0x00, 0x00, 0x00, 0x00, 0x00, 0x01, 0xff, 0xff, 0x00, 0x00, 0x00, 0x00, 0x00, 0x00, 
  0x00, 0x00, 0x00, 0x00, 0x00, 0x00, 0x00, 0x7f, 0xff, 0xff, 0xfc, 0x00, 0x00, 0x00, 0x00, 0x00, 
  0x00, 0x00, 0x00, 0x00, 0x00, 0x00, 0x03, 0xff, 0xff, 0xff, 0xff, 0xc0, 0x00, 0x00, 0x00, 0x00, 
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  0xff, 0xff, 0xff, 0xff, 0xff, 0xff, 0xff, 0xff, 0xff, 0xff, 0xff, 0xff, 0xff, 0xff, 0xff, 0xff
};


// 'burglar', 128x64px
const unsigned char burglar [] PROGMEM = {
  0x00, 0x00, 0x00, 0x00, 0x00, 0x00, 0x00, 0x00, 0x00, 0x00, 0x00, 0x00, 0x00, 0x00, 0x00, 0x00, 
  0x00, 0x00, 0x00, 0x00, 0x00, 0x00, 0x00, 0x00, 0x00, 0x00, 0x00, 0x00, 0x00, 0x00, 0x00, 0x00, 
  0x00, 0x00, 0x00, 0x00, 0x00, 0x00, 0x01, 0xff, 0xfc, 0x00, 0x00, 0x00, 0x00, 0x00, 0x00, 0x00, 
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  0x00, 0x00, 0x00, 0x00, 0x00, 0x00, 0x00, 0x00, 0x00, 0x00, 0x00, 0x00, 0x00, 0x00, 0x00, 0x00
};

// 'eye', 128x64px
const unsigned char eye [] PROGMEM = {
  0xff, 0xff, 0xff, 0xff, 0xff, 0xff, 0xff, 0xff, 0xff, 0xff, 0xff, 0xff, 0xff, 0xff, 0xff, 0xff, 
  0xff, 0xff, 0xff, 0xff, 0xff, 0xff, 0xff, 0xff, 0xff, 0xff, 0xff, 0xff, 0xff, 0xff, 0xff, 0xff, 
  0xff, 0xff, 0xff, 0xff, 0xff, 0xff, 0xff, 0xff, 0xff, 0xff, 0xff, 0xff, 0xff, 0xff, 0xff, 0xff, 
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  0xff, 0xff, 0xff, 0xff, 0xff, 0xff, 0xff, 0xff, 0xff, 0xff, 0xff, 0xff, 0xff, 0xff, 0xff, 0xff
};

// 'alarm', 128x64px
const unsigned char alarm [] PROGMEM = {
0xff, 0xff, 0xff, 0xff, 0xff, 0xff, 0xff, 0xff, 0xff, 0xff, 0xff, 0xff, 0xff, 0xff, 0xff, 0xff, 
0xff, 0xff, 0xff, 0xff, 0xff, 0xff, 0xff, 0xff, 0xff, 0xff, 0xff, 0xff, 0xff, 0xff, 0xff, 0xff, 
0xe0, 0x00, 0x00, 0x00, 0x00, 0x00, 0x00, 0x00, 0x00, 0x00, 0x00, 0x00, 0x00, 0x00, 0x00, 0x07, 
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0xff, 0xff, 0xff, 0xff, 0xff, 0xff, 0xff, 0xff, 0xff, 0xff, 0xff, 0xff, 0xff, 0xff, 0xff, 0xff
};


int motionNum = 0; 
int pirValue = 0;

String temp="";
String hum = "";

String wait = "I need some time to recover";
String amready = "I'm ready to catch some folks";
String detected = "Bulglar alarm !!!";

void setup() {

Serial.begin(9600);
if(!display.begin(SSD1306_SWITCHCAPVCC, 0x3C)) { // Address 0x3D for 128x64
   Serial.println(F("SSD1306 allocation failed"));
   for(;;); // Don't proceed, loop forever
 }
 display.clearDisplay();
 display.display();

pinMode(detectedLED, OUTPUT);
pinMode(waitLED, OUTPUT);
pinMode(readyLED, OUTPUT);
pinMode(speaker, OUTPUT);

pinMode(sensor, INPUT);

digitalWrite(detectedLED, LOW);
digitalWrite(readyLED, LOW);
digitalWrite(waitLED, HIGH);

display.clearDisplay();
display.drawBitmap(0,0,sleep,128,64,WHITE);
display.display();
  
delay(60000);

display.clearDisplay();
display.drawBitmap(0,0,eye,128,64,WHITE);
display.display();
digitalWrite(readyLED,HIGH);
digitalWrite(waitLED, LOW);

}

void loop() {

pirValue = digitalRead(sensor);

Serial.println("sensor value: ");
Serial.print(pirValue);

if(pirValue == 1){
  digitalWrite(detectedLED, HIGH);
  digitalWrite(readyLED, LOW);
  digitalWrite(speaker,HIGH);
  motionNum = 1;
  for(int k=0; k<4; k++){

  display.clearDisplay();
  display.drawBitmap(0,0,burglar,128,64,WHITE);
  display.display();
  
   for (int i = 0; i<256; i++){
      analogWrite(speaker,i);
      delay(5); 
    }
    
  display.clearDisplay();
  display.drawBitmap(0,0,alarm,128,64,WHITE);
  display.display();
  
   for (int p = 1; p<3; p++){
      digitalWrite(speaker,HIGH);
      delay(500);
      digitalWrite(speaker,LOW);
      delay(300);
   }
   
  display.clearDisplay();
  display.drawBitmap(0,0,burglar,128,64,WHITE);
  display.display();
      
    for(int i = 255; i>-1; i--){
       analogWrite(speaker,i);
       delay(5);
    }
  }
 
} else {
  
  digitalWrite(detectedLED,LOW);
  
}
if(motionNum == 1) {
  digitalWrite(speaker,LOW);
  digitalWrite(detectedLED, LOW);
  digitalWrite(readyLED, LOW);
  
  display.clearDisplay();
  display.drawBitmap(0,0,sleep,128,64,WHITE);
  display.display();
  
  digitalWrite(waitLED, HIGH);
  
  delay(6000);
  
  digitalWrite(readyLED, HIGH);
  digitalWrite(waitLED, LOW);
  display.clearDisplay();
  display.drawBitmap(0,0,eye,128,64,WHITE);
  display.display();
  
  motionNum = 0;
}


}

/*void picture(const unsigned char nam){
  display.clearDisplay();
  display.drawBitmap(0,0,nam,128,64,WHITE);
  display.drawBitmap(0,0,burglar,128,64,WHITE);
  display.display();
}*/

void back() {
  
temp = "Temperature: " ;
hum = "Humidity: " ;

}

void writing(String text, int x, int y, int size, boolean d){
  display.setTextSize(size);
  display.setTextColor(WHITE);
  display.setCursor(x,y);
  display.println(text);

  if(d) {display.display();}
}
